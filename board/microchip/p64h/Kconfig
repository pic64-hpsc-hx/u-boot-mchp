## board/microchip/p64h/Kconfig
```kconfig
if TARGET_MICROCHIP_P64H

config SYS_BOARD
	default "p64h"

config SYS_VENDOR
	default "microchip"

config SYS_CPU
	default "generic"

config SYS_CONFIG_NAME
	default "microchip_p64h"

config TEXT_BASE
	default 0x4000000000 if !RISCV_SMODE
	default 0x4000200000 if RISCV_SMODE

config BOARD_SPECIFIC_OPTIONS
	def_bool y
	select GENERIC_RISCV
	imply SMP
	imply BOARD_LATE_INIT
	imply SYS_NS16550

config P64H_NO_DDR
	bool "No DDR mode for P64H"
	default n
	help
	  Choose this option to enable the No DDR mode of P64H. This cause U-Boot
	  to ignore the /memory node of the device tree and force itself into
	  OCR 0 and 1 (1 MiB)

endif
```

## configs/microchip_p64h_c0_defconfig
```kconfig
CONFIG_RISCV=y
CONFIG_NR_DRAM_BANKS=1
CONFIG_ENV_SIZE=0x20000
CONFIG_DEFAULT_DEVICE_TREE="p64h-hb130x-hb1341-on-fmc1"
CONFIG_SYS_LOAD_ADDR=0x4010000000
CONFIG_TARGET_MICROCHIP_P64H=y
CONFIG_ARCH_RV64I=y
CONFIG_FRAMEPOINTER=y
CONFIG_RISCV_SMODE=y
CONFIG_SHOW_REGS=y
CONFIG_SYS_MEMTEST_START=0x4000000000
CONFIG_SYS_MEMTEST_END=0x4000001000
CONFIG_CC_OPTIMIZE_FOR_DEBUG=y
CONFIG_FIT=y
CONFIG_BOOTSTD_DEFAULTS=y
CONFIG_SYS_BOOTM_LEN=0x2000000
CONFIG_BOOTCOMMAND="tftp 0x4010000000 linux_fit.itb; bootm 0x4010000000"
CONFIG_DEFAULT_FDT_FILE="p64h-hb130x.dtb"
CONFIG_LOGLEVEL=8
CONFIG_LOG=y
CONFIG_LOG_MAX_LEVEL=8
CONFIG_LOG_DEFAULT_LEVEL=4
CONFIG_LAST_STAGE_INIT=y
# CONFIG_CMD_BOOTD is not set
# CONFIG_CMD_BOOTFLOW is not set
# CONFIG_CMD_BOOTI is not set
# CONFIG_CMD_ELF is not set
# CONFIG_CMD_FDT is not set
# CONFIG_CMD_GO is not set
# CONFIG_CMD_IMI is not set
# CONFIG_CMD_XIMG is not set
CONFIG_CMD_MEMTEST=y
CONFIG_SYS_ALT_MEMTEST=y
CONFIG_CMD_I2C=y
CONFIG_CMD_MTD=y
CONFIG_CMD_NAND_TRIMFFS=y
CONFIG_CMD_NAND_LOCK_UNLOCK=y
CONFIG_CMD_NAND_TORTURE=y
# CONFIG_CMD_BLOCK_CACHE is not set
CONFIG_CMD_MTDPARTS=y
CONFIG_CMD_UBI=y
# CONFIG_DOS_PARTITION is not set
# CONFIG_ISO_PARTITION is not set
# CONFIG_EFI_PARTITION is not set
CONFIG_OF_BOARD=y
CONFIG_ENV_OVERWRITE=y
CONFIG_SYS_RELOC_GD_ENV_ADDR=y
CONFIG_USE_IPADDR=y
CONFIG_IPADDR="192.168.1.2"
CONFIG_USE_SERVERIP=y
CONFIG_SERVERIP="192.168.1.1"
CONFIG_REGMAP=y
CONFIG_SYSCON=y
# CONFIG_GPIO is not set
CONFIG_DM_I2C=y
CONFIG_SYS_I2C_DW=y
# CONFIG_INPUT is not set
CONFIG_MTD_NOR_FLASH=y
CONFIG_CFI_FLASH=y
CONFIG_FLASH_CFI_MTD=y
CONFIG_SYS_MAX_FLASH_BANKS_DETECT=y
CONFIG_MTD_RAW_NAND=y
CONFIG_SYS_MAX_NAND_DEVICE=8
CONFIG_NAND_MCHP_P64H=y
CONFIG_SYS_NAND_ONFI_DETECTION=y
CONFIG_SYS_NAND_MAX_CHIPS=8
CONFIG_UBI_SILENCE_MSG=y
CONFIG_PHY_MSCC=y
CONFIG_PHY_FIXED=y
CONFIG_DM_MDIO=y
CONFIG_DM_ETH_PHY=y
CONFIG_PHY_GIGE=y
CONFIG_MACB=y
CONFIG_P64H_MDIO=y
CONFIG_DEFAULT_ENV_IS_RW=y
CONFIG_NS16550_DYNAMIC=y
# CONFIG_SHA256 is not set
CONFIG_HEXDUMP=y
# CONFIG_EFI_LOADER is not set
```

## configs/microchip_p64h_defconfig
```kconfig
CONFIG_RISCV=y
CONFIG_NR_DRAM_BANKS=1
CONFIG_DEFAULT_DEVICE_TREE="p64h-hb130x-hb1341-on-fmc1"
CONFIG_SYS_LOAD_ADDR=0x7000000000
CONFIG_TARGET_MICROCHIP_P64H=y
CONFIG_ARCH_RV64I=y
CONFIG_FRAMEPOINTER=y
CONFIG_RISCV_SMODE=y
CONFIG_SHOW_REGS=y
CONFIG_SYS_MEMTEST_START=0x4000000000
CONFIG_SYS_MEMTEST_END=0x4000001000
CONFIG_CC_OPTIMIZE_FOR_DEBUG=y
CONFIG_FIT=y
CONFIG_SYS_BOOTM_LEN=0x1000000
CONFIG_USE_BOOTCOMMAND=y
CONFIG_BOOTCOMMAND="tftp 0x4010000000 linux_fit.itb; bootm 0x4010000000"
CONFIG_DEFAULT_FDT_FILE="p64h-hb130x.dtb"
CONFIG_LOGLEVEL=8
CONFIG_LOG=y
CONFIG_LOG_MAX_LEVEL=8
CONFIG_LOG_DEFAULT_LEVEL=6
CONFIG_LAST_STAGE_INIT=y
# CONFIG_CMD_BOOTD is not set
# CONFIG_CMD_BOOTFLOW is not set
# CONFIG_CMD_BOOTI is not set
# CONFIG_CMD_ELF is not set
# CONFIG_CMD_FDT is not set
# CONFIG_CMD_GO is not set
# CONFIG_CMD_RUN is not set
# CONFIG_CMD_IMI is not set
# CONFIG_CMD_XIMG is not set
CONFIG_CMD_MEMTEST=y
CONFIG_SYS_ALT_MEMTEST=y
CONFIG_CMD_DHCP=y
CONFIG_CMD_MII=y
CONFIG_CMD_PING=y
# CONFIG_CMD_BLOCK_CACHE is not set
CONFIG_OF_BOARD=y
CONFIG_USE_IPADDR=y
CONFIG_IPADDR="192.168.1.2"
CONFIG_USE_SERVERIP=y
CONFIG_SERVERIP="192.168.1.1"
CONFIG_REGMAP=y
CONFIG_SYSCON=y
# CONFIG_GPIO is not set
# CONFIG_I2C is not set
# CONFIG_INPUT is not set
CONFIG_PHY_MSCC=y
CONFIG_PHY_FIXED=y
CONFIG_DM_MDIO=y
CONFIG_DM_ETH_PHY=y
CONFIG_MACB=y
CONFIG_P64H_MDIO=y
CONFIG_DEFAULT_ENV_IS_RW=y
CONFIG_NS16550_DYNAMIC=y
# CONFIG_SHA256 is not set
CONFIG_HEXDUMP=y
# CONFIG_EFI_LOADER is not set
```

## configs/microchip_p64h_qemu_c0_defconfig
```kconfig
CONFIG_RISCV=y
CONFIG_SKIP_LOWLEVEL_INIT=y
CONFIG_SYS_MALLOC_LEN=0x800000
CONFIG_NR_DRAM_BANKS=1
CONFIG_HAS_CUSTOM_SYS_INIT_SP_ADDR=y
CONFIG_CUSTOM_SYS_INIT_SP_ADDR=0x4000200000
CONFIG_ENV_SIZE=0x20000
CONFIG_DEFAULT_DEVICE_TREE="p64h"
CONFIG_SYS_LOAD_ADDR=0x4000200000
CONFIG_ENV_ADDR=0x47200000000
CONFIG_PCI=y
CONFIG_TARGET_MICROCHIP_P64H=y
CONFIG_ARCH_RV64I=y
CONFIG_FRAMEPOINTER=y
CONFIG_CMODEL_MEDANY=y
CONFIG_RISCV_SMODE=y
CONFIG_RISCV_ISA_ZBB=y
CONFIG_XIP=y
CONFIG_SHOW_REGS=y
CONFIG_CC_OPTIMIZE_FOR_DEBUG=y
CONFIG_ENV_VARS_UBOOT_CONFIG=y
CONFIG_FIT=y
CONFIG_FIT_VERBOSE=y
# CONFIG_BOOTSTD_BOOTCOMMAND is not set
CONFIG_SYS_BOOTM_LEN=0x4000000
CONFIG_SUPPORT_RAW_INITRD=y
CONFIG_USE_BOOTCOMMAND=y
CONFIG_BOOTCOMMAND="run distro_bootcmd"
CONFIG_USE_PREBOOT=y
CONFIG_PREBOOT="setenv fdt_addr ${fdtcontroladdr}; fdt addr ${fdtcontroladdr};"
CONFIG_CONSOLE_FLUSH_ON_NEWLINE=y
CONFIG_CONSOLE_MUX=y
CONFIG_SYS_STDIO_DEREGISTER=y
CONFIG_DISPLAY_CPUINFO=y
CONFIG_DISPLAY_BOARDINFO=y
CONFIG_PCI_INIT_R=y
CONFIG_STACKPROTECTOR=y
CONFIG_HUSH_PARSER=y
CONFIG_CMD_SBI=y
# CONFIG_BOOTM_NETBSD is not set
# CONFIG_BOOTM_PLAN9 is not set
# CONFIG_BOOTM_RTEMS is not set
# CONFIG_CMD_BOOTEFI is not set
CONFIG_CMD_MEMINFO=y
# CONFIG_CMD_NVME is not set
CONFIG_CMD_PART=y
CONFIG_CMD_PCI=y
# CONFIG_CMD_ITEST is not set
CONFIG_CMD_XXD=y
CONFIG_CMD_DHCP=y
CONFIG_CMD_NFS=y
CONFIG_CMD_WGET=y
CONFIG_CMD_PING=y
CONFIG_CMD_PXE=y
CONFIG_CMD_CLS=y
# CONFIG_CMD_EFICONFIG is not set
CONFIG_CMD_EXT2=y
CONFIG_CMD_EXT4=y
CONFIG_CMD_FAT=y
CONFIG_CMD_FS_GENERIC=y
CONFIG_ISO_PARTITION=y
CONFIG_OF_BOARD=y
CONFIG_OF_OMIT_DTB=y
CONFIG_ENV_IS_NOWHERE=y
CONFIG_ENV_IS_IN_NVRAM=y
CONFIG_ENV_IMPORT_FDT=y
CONFIG_DM_WARN=y
# CONFIG_I2C is not set
# CONFIG_INPUT is not set
CONFIG_DM_MTD=y
CONFIG_MTD_NOR_FLASH=y
CONFIG_CFI_FLASH=y
CONFIG_FLASH_CFI_MTD=y
CONFIG_SYS_MAX_FLASH_BANKS=4
CONFIG_SYS_MAX_FLASH_BANKS_DETECT=y
CONFIG_MACB=y
CONFIG_NVME_PCI=y
CONFIG_PCIE_ECAM_GENERIC=y
CONFIG_DM_RNG=y
CONFIG_DM_RTC=y
CONFIG_RTC_GOLDFISH=y
CONFIG_HTIF_CONSOLE=y
CONFIG_SIFIVE_SERIAL=y
CONFIG_SYSRESET=y
CONFIG_SYSRESET_SYSCON=y
CONFIG_VIRTIO_MMIO=y
CONFIG_VIRTIO_PCI=y
CONFIG_VIRTIO_NET=y
CONFIG_VIRTIO_BLK=y
CONFIG_HEXDUMP=y
```

## configs/microchip_p64h_qemu_c1_defconfig
```kconfig
CONFIG_RISCV=y
CONFIG_SKIP_LOWLEVEL_INIT=y
CONFIG_TEXT_BASE=0x5000200000
CONFIG_SYS_MALLOC_LEN=0x800000
CONFIG_NR_DRAM_BANKS=1
CONFIG_HAS_CUSTOM_SYS_INIT_SP_ADDR=y
CONFIG_CUSTOM_SYS_INIT_SP_ADDR=0x5000200000
CONFIG_ENV_SIZE=0x20000
CONFIG_DEFAULT_DEVICE_TREE="p64h-qemu"
CONFIG_SYS_LOAD_ADDR=0x5000200000
CONFIG_ENV_ADDR=0x47208000000
# CONFIG_AHCI is not set
CONFIG_TARGET_QEMU_MICROCHIP_P64H=y
CONFIG_ARCH_RV64I=y
CONFIG_FRAMEPOINTER=y
CONFIG_CMODEL_MEDANY=y
CONFIG_RISCV_SMODE=y
CONFIG_RISCV_ISA_ZBB=y
CONFIG_XIP=y
CONFIG_SHOW_REGS=y
CONFIG_CC_OPTIMIZE_FOR_DEBUG=y
CONFIG_ENV_VARS_UBOOT_CONFIG=y
CONFIG_FIT=y
CONFIG_FIT_VERBOSE=y
# CONFIG_BOOTSTD_BOOTCOMMAND is not set
CONFIG_SYS_BOOTM_LEN=0x4000000
CONFIG_SUPPORT_RAW_INITRD=y
CONFIG_USE_BOOTCOMMAND=y
CONFIG_BOOTCOMMAND="run distro_bootcmd"
CONFIG_USE_PREBOOT=y
CONFIG_PREBOOT="setenv fdt_addr ${fdtcontroladdr}; fdt addr ${fdtcontroladdr};"
# CONFIG_PRE_CONSOLE_BUFFER is not set
CONFIG_CONSOLE_FLUSH_ON_NEWLINE=y
CONFIG_CONSOLE_MUX=y
CONFIG_SYS_STDIO_DEREGISTER=y
CONFIG_DISPLAY_CPUINFO=y
CONFIG_DISPLAY_BOARDINFO=y
CONFIG_STACKPROTECTOR=y
CONFIG_HUSH_PARSER=y
# CONFIG_BOOTM_NETBSD is not set
# CONFIG_BOOTM_PLAN9 is not set
# CONFIG_BOOTM_RTEMS is not set
# CONFIG_CMD_BOOTEFI is not set
CONFIG_CMD_MEMINFO=y
# CONFIG_CMD_NVME is not set
CONFIG_CMD_PART=y
# CONFIG_CMD_POWEROFF is not set
# CONFIG_CMD_ITEST is not set
CONFIG_CMD_XXD=y
CONFIG_CMD_DHCP=y
CONFIG_CMD_NFS=y
CONFIG_CMD_WGET=y
CONFIG_CMD_PXE=y
CONFIG_CMD_CLS=y
# CONFIG_CMD_EFICONFIG is not set
# CONFIG_EFI_PARTITION is not set
CONFIG_ENV_IS_NOWHERE=y
CONFIG_ENV_IS_IN_NVRAM=y
CONFIG_ENV_IMPORT_FDT=y
CONFIG_DM_WARN=y
# CONFIG_SCSI_AHCI is not set
# CONFIG_I2C is not set
# CONFIG_INPUT is not set
CONFIG_DM_MTD=y
CONFIG_FLASH_CFI_MTD=y
CONFIG_SYS_MAX_FLASH_BANKS=4
CONFIG_SYS_MAX_FLASH_BANKS_DETECT=y
# CONFIG_E1000 is not set
CONFIG_MACB=y
# CONFIG_SCSI is not set
# CONFIG_USB is not set
CONFIG_HEXDUMP=y
```
